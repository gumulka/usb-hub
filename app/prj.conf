## prj.conf
```kconfig
CONFIG_I2C=y

CONFIG_SHELL=y
CONFIG_I2C_SHELL=y
CONFIG_GPIO_SHELL=y
CONFIG_DEVICE_SHELL=y
```

## debug.conf
```kconfig
# Copyright (c) 2024 Fabian Pflug
# SPDX-License-Identifier: Apache-2.0

# compiler
CONFIG_DEBUG_OPTIMIZATIONS=y

CONFIG_LOG=y
CONFIG_CONSOLE=y

CONFIG_SHELL=y
CONFIG_I2C_SHELL=y
CONFIG_GPIO_SHELL=y
CONFIG_DEVICE_SHELL=y
```

## src/main.c
```c
/*
 * Copyright (c) 2024 Fabian Pflug
 * SPDX-License-Identifier: Apache-2.0
 */

#include <zephyr/kernel.h>

#include <zephyr/logging/log.h>
LOG_MODULE_REGISTER(main, CONFIG_APP_LOG_LEVEL);

int main(void)
{
	LOG_INF("Hello from Application!");
	return 0;
}
```
