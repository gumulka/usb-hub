## boards/arm/fabians-usb-hub/fabians_usb_hub_defconfig
```kconfig
# SPDX-License-Identifier: Apache-2.0

CONFIG_SOC_SERIES_STM32L1X=y

CONFIG_SOC_STM32L151XC=y

# enable GPIO
CONFIG_GPIO=y

# Enable Clocks
CONFIG_CLOCK_CONTROL=y

# enable pin controller
CONFIG_PINCTRL=y

CONFIG_SERIAL=y
CONFIG_CONSOLE=y
CONFIG_UART_CONSOLE=y
```

## drivers/Kconfig
```kconfig
# Copyright (c) 2024 Fabian Pflug
# SPDX-License-Identifier: Apache-2.0

menu "Drivers"
rsource "ports/Kconfig"
endmenu
```

## drivers/ports/Kconfig
```kconfig
# Copyright (c) 2024 Fabian Pflug
# SPDX-License-Identifier: Apache-2.0

config HUB_PORTS
	bool "usb hub ports device drivers"
	default y
	depends on DT_HAS_USB_HUB_PORTS_ENABLED
	select GPIO
	help
	  Custom driver class for usb-hub ports to be toggled via request GPIO's or
	  via call to it.

if HUB_PORTS

module = HUB_PORTS
module-str = HUB_PORTS
source "subsys/logging/Kconfig.template.log_config"

endif # HUB_PORTS
```

## dts/bindings/usb-hub/usb-hub-ports.yaml
```yaml
# Copyright (c) 2024 Fabian Pflug
# SPDX-License-Identifier: Apache-2.0

description: |
  Port toggle binding for my usb hub. Each enable GPIO is an output, that is
  connected to the MOSFET, that enables power for the USB port. Each request
  GPIO is connected to a button, that should toggle the output of the
  corresponding enable gpio.

compatible: "usb-hub-ports"

include: base.yaml

properties:
  enable-gpios:
    type: phandle-array
    required: true
    description: Array of IO pins to activate the usb hub ports

  request-gpios:
    type: phandle-array
    required: true
    description: Array of IO pins to request a toggle of the usb hub ports
```

## west.yml
```yaml
# Copyright (c) 2024 Fabian Pflug
# SPDX-License-Identifier: Apache-2.0

manifest:
  remotes:
    - name: zephyrproject-rtos
      url-base: https://github.com/zephyrproject-rtos
    - name: gumulka
      url-base: https://github.com/gumulka

  projects:
    - name: zephyr
      remote: zephyrproject-rtos
      revision: v3.6.0
      import:
        name-allowlist:
          - cmsis
          - hal_stm32
          - segger
    - name: mcuboot
      remote: gumulka
      revision: 859688998261c16e2be230a7d0f400de56811160
      path: bootloader/mcuboot
```
