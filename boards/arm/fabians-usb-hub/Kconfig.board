## boards/arm/fabians-usb-hub/Kconfig.board
```kconfig
# Copyright (c) 2024 Fabian Pflug
# SPDX-License-Identifier: Apache-2.0

config FABIANS_USB_HUB
	bool "Fabians USB Hub"
	depends on SOC_STM32F072XB
```

## boards/arm/fabians-usb-hub/Kconfig.defconfig
```kconfig
# Copyright (c) 2024 Fabian Pflug
# SPDX-License-Identifier: Apache-2.0

if FABIANS_USB_HUB

config BOARD
	default "fabians_usb_hub"

endif # FABIANS_USB_HUB
```
